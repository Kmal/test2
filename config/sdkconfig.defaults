## config/sdkconfig.defaults
```kconfig
## Default SDK configuration for the StickS3 board-support project
##
## The StickS3 uses ESP32-S3-PICO-1-N8R8. ESP32-S3 does not support
## Bluetooth Classic / BR/EDR, so Classic Bluetooth HFP and SCO-over-HCI are
## not enabled in the StickS3 defaults. The default transport is a custom
## Bluetooth Low Energy GATT status and rule-event service.

CONFIG_APP_TRANSPORT_BLE_GATT_PCM=y
CONFIG_APP_BLE_GATT_DEVICE_NAME="M5StickS3-Control"
CONFIG_APP_WIFI_ENABLE=y
CONFIG_APP_WIFI_AP_SSID="M5StickS3-Setup"
CONFIG_APP_WIFI_AP_PASSWORD=""
CONFIG_APP_WIFI_AP_CHANNEL=6
CONFIG_APP_WIFI_KEYBOARD_PROVISIONING=n
CONFIG_BT_ENABLED=y
CONFIG_BT_NIMBLE_ENABLED=y

## Prefer a larger ATT MTU for structured status and rule-event notifications.
CONFIG_BT_NIMBLE_ATT_PREFERRED_MTU=247

CONFIG_ESPTOOLPY_FLASHSIZE_8MB=y
CONFIG_ESPTOOLPY_FLASHSIZE="8MB"
CONFIG_SPIRAM=y
CONFIG_SPIRAM_MODE_OCT=y

## Avoid first-boot RF calibration load warnings on freshly erased NVS by using
## full RF calibration instead of trying to load missing partial-calibration data.
CONFIG_ESP_PHY_CALIBRATION_AND_DATA_STORAGE=n

CONFIG_APP_STATUS_UI_LCD_REFRESH_MS=100
## The rule automation config is intentionally kept off app_main()'s stack,
## but ESP-IDF startup plus board/BLE bring-up still benefits from explicit
## headroom over the default main task stack.
CONFIG_ESP_MAIN_TASK_STACK_SIZE=8192

## Use a custom 8 MB partition table so the BLE/Wi-Fi/LCD/rule-automation app
## fits. ESP-IDF's default single factory app slot is only 1 MiB, which is too
## small for this firmware and leaves the board in a bootloader reset loop.
CONFIG_PARTITION_TABLE_CUSTOM=y
CONFIG_PARTITION_TABLE_CUSTOM_FILENAME="partitions.csv"
CONFIG_PARTITION_TABLE_FILENAME="partitions.csv"
```

## main/Kconfig.projbuild
```kconfig
menu "StickS3 application transport"

choice APP_TRANSPORT
    prompt "Application transport"
    default APP_TRANSPORT_BLE_GATT_PCM
    help
        Select the application transport used by the configuration and
        automation firmware.

config APP_TRANSPORT_NONE
    bool "No wireless event transport selected"
    help
        Board bring-up only. The firmware initializes local UI, Wi-Fi, and
        automation support without a BLE rule-event service.

config APP_TRANSPORT_BLE_GATT_PCM
    bool "Bluetooth LE GATT rule-event transport"
    select BT_ENABLED
    help
        Start a custom Bluetooth Low Energy GATT service for status reads and
        local automation rule-event notifications. This transport does not
        expose microphone, PCM, sound-level, or display-mode compatibility
        characteristics.

config APP_TRANSPORT_HFP_LEGACY
    bool "Legacy Classic Bluetooth HFP transport (not StickS3/ESP32-S3)"
    depends on !IDF_TARGET_ESP32S3
    select BT_ENABLED
    select BT_HFP_CLIENT_ENABLE
    help
        Historical code path for non-ESP32-S3 targets that support Bluetooth
        Classic. It is quarantined and intentionally errors until refreshed;
        do not enable this for M5Stack StickS3.

endchoice

if APP_TRANSPORT_BLE_GATT_PCM

config APP_BLE_GATT_DEVICE_NAME
    string "BLE GATT device name"
    default "M5StickS3-Control"

endif

endmenu


menu "StickS3 Wi-Fi and web UI"

config APP_WIFI_ENABLE
    bool "Enable Wi-Fi station/setup AP for web UI"
    default y
    help
        Start ESP-IDF Wi-Fi during boot, try saved station credentials, and
        fall back to a setup access point so the local HTTP configuration UI is
        reachable from a browser.

config APP_WIFI_AP_SSID
    string "Setup access point SSID"
    default "M5StickS3-Setup"
    depends on APP_WIFI_ENABLE

config APP_WIFI_AP_PASSWORD
    string "Setup access point password (blank for open AP)"
    default ""
    depends on APP_WIFI_ENABLE
    help
        Leave blank for an open setup AP. If set, ESP Wi-Fi requires at least
        eight characters for WPA2-PSK.

config APP_WIFI_AP_CHANNEL
    int "Setup access point channel"
    default 6
    range 1 13
    depends on APP_WIFI_ENABLE

config APP_WIFI_AP_MAX_CONNECTIONS
    int "Setup access point max clients"
    default 4
    range 1 8
    depends on APP_WIFI_ENABLE

config APP_WIFI_CONNECT_TIMEOUT_MS
    int "Station connection timeout in milliseconds"
    default 8000
    range 1000 60000
    depends on APP_WIFI_ENABLE

config APP_WIFI_MAX_SCAN_RESULTS
    int "Maximum Wi-Fi scan results shown in web UI"
    default 12
    range 1 32
    depends on APP_WIFI_ENABLE

config APP_WIFI_KEYBOARD_PROVISIONING
    bool "Prompt for Wi-Fi credentials on the LCD keyboard at boot"
    default n
    depends on APP_WIFI_ENABLE && APP_STATUS_UI_LCD
    help
        When saved station credentials are missing or fail, show a Launcher-style
        virtual keyboard on the StickS3 LCD before falling back to the setup AP.
        This is disabled by default so boot continues to the normal dashboard and
        credentials can be entered from Connect to Wi-Fi or the setup AP web UI.

config APP_WIFI_KEYBOARD_TIMEOUT_MS
    int "LCD keyboard provisioning timeout in milliseconds"
    default 0
    range 0 300000
    depends on APP_WIFI_KEYBOARD_PROVISIONING
    help
        Timeout for each SSID/password keyboard prompt. Set to 0 to wait
        indefinitely.

endmenu

menu "StickS3 status UI"

config APP_STATUS_UI_LCD
    bool "Render debug status on the onboard ST7789P3 LCD"
    default y
    help
        Initialize the StickS3 onboard 135x240 ST7789P3 LCD and render a
        local configuration launcher. If LCD initialization
        fails, button polling and transport startup continue.

config APP_STATUS_UI_LCD_REFRESH_MS
    int "LCD refresh period in ms"
    default 100
    range 50 2000
    depends on APP_STATUS_UI_LCD

endmenu
```
